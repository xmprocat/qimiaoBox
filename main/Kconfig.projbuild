## sdkconfig.defaults
```kconfig
CONFIG_LV_CONF_SKIP=y
CONFIG_LV_USE_OBSERVER=y
CONFIG_LV_USE_SYSMON=y
CONFIG_LV_USE_PERF_MONITOR=y

# Partition table: custom with NVS
CONFIG_PARTITION_TABLE_CUSTOM=y
CONFIG_PARTITION_TABLE_CUSTOM_FILENAME="partitions.csv"

# Flash size: ESP32C6-N4 has 4MB flash
CONFIG_ESPTOOLPY_FLASHSIZE_4MB=y
CONFIG_ESPTOOLPY_FLASHSIZE="4MB"

# WiFi STA
CONFIG_ESP_WIFI_ENABLED=y
CONFIG_ESP_WIFI_STA_ENABLED=y
CONFIG_ESP_WIFI_SOFTAP_SUPPORT=n

# Console: USB Serial JTAG (ESP32-C6 内置 USB)
CONFIG_ESP_CONSOLE_USB_SERIAL_JTAG=y

# LVGL PNG support (lodepng)
CONFIG_LV_USE_LODEPNG=y
```
